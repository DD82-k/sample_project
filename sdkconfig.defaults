## sdkconfig.defaults
```kconfig
CONFIG_ESP32S3_SPIRAM_SUPPORT=y
CONFIG_SPIRAM=y
CONFIG_SPIRAM_MODE_OCT=y
CONFIG_SPIRAM_SPEED_80M=y
CONFIG_SPIRAM_USE_CAPS_ALLOC=y
CONFIG_SPIRAM_USE_MALLOC=y

# WiFi 配置 (protocol_examples_common)
CONFIG_EXAMPLE_CONNECT_WIFI=y
CONFIG_EXAMPLE_WIFI_SSID="Honor60se"
CONFIG_EXAMPLE_WIFI_PASSWORD="8899ppoo"
CONFIG_EXAMPLE_WIFI_CONN_MAX_RETRY=6
```
